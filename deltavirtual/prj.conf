## CMakeLists.txt
```
cmake_minimum_required(VERSION 3.20.0)
find_package(Zephyr REQUIRED HINTS $ENV{ZEPHYR_BASE})
project(deltavirtual)

target_sources(app PRIVATE src/main.c)
```

## prj.conf
```kconfig
CONFIG_GPIO=y

# Console on hardware UART (for Renode). The promicro board defaults to
# USB CDC ACM, which the simulator does not provide. Disable the CDC serial
# backend and route console to uart0 via boards/promicro_nrf52840_nrf52840.overlay.
CONFIG_BOARD_SERIAL_BACKEND_CDC_ACM=n
CONFIG_SERIAL=y
CONFIG_CONSOLE=y
CONFIG_UART_CONSOLE=y
```

## boards/promicro_nrf52840_nrf52840.overlay
```dts
/*
 * Route Zephyr console/shell to the hardware UART so Renode can show it
 * in `showAnalyzer uart0`. The default promicro_nrf52840 console is USB
 * CDC ACM, which Renode does not emulate.
 *
 * UART0 on this board is P0.09 (TX) / P0.10 (RX).
 */

/ {
	chosen {
		zephyr,console = &uart0;
		zephyr,shell-uart = &uart0;
		zephyr,uart-mcumgr = &uart0;
		zephyr,bt-mon-uart = &uart0;
		zephyr,bt-c2h-uart = &uart0;
	};
};
```

## src/main.c
```c
#include <zephyr/kernel.h>
#include <zephyr/sys/printk.h>

int main(void){

    while(1){
        printk("nrf nrf nrf nrf!\n");
        k_sleep(K_SECONDS(1));
    }
    return 0;
}
```
